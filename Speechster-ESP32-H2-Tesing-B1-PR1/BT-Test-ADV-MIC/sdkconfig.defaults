## Speechster-ESP32-H2-Tesing-B1-PR1/BT-Test-ADV-MIC/sdkconfig.defaults
```kconfig
# ===== Target Chip =====
CONFIG_IDF_TARGET="esp32h2"
CONFIG_IDF_TARGET_ESP32H2=y
CONFIG_ESP32H2_DEFAULT_CPU_FREQ_96=y
CONFIG_ESP32H2_DEFAULT_CPU_FREQ_MHZ=96

# ===== FreeRTOS =====
CONFIG_FREERTOS_UNICORE=y
CONFIG_FREERTOS_HZ=1000
CONFIG_FREERTOS_MAX_TASK_NAME_LEN=16
CONFIG_FREERTOS_SUPPORT_STATIC_ALLOCATION=y
CONFIG_FREERTOS_ENABLE_STACK_OVERFLOW_CHECK=y
CONFIG_FREERTOS_CHECK_MUTEX_GIVEN_BY_OWNER=y

# ===== BLE / NimBLE =====
CONFIG_BT_ENABLED=y
CONFIG_BT_NIMBLE_ENABLED=y
CONFIG_BT_NIMBLE_CONTROLLER=esp_nimble_hci
CONFIG_BT_BLUEDROID_ENABLED=n
CONFIG_BT_NIMBLE_ROLE_CENTRAL=n
CONFIG_BT_NIMBLE_ROLE_PERIPHERAL=y
CONFIG_BT_NIMBLE_ATT_PREPARE_QUEUE_SIZE=10
CONFIG_BT_NIMBLE_GATT_MAX_SERVICE_COUNT=4
CONFIG_BT_NIMBLE_HS_FLOW_CONTROL=y

# ===== I2S =====
CONFIG_I2S_SUPPORT=y
CONFIG_I2S_STD_ENABLED=y
CONFIG_I2S_SUPPORTS_ADC=y
CONFIG_I2S_ISR_IRAM_SAFE=y

# ===== Logging =====
CONFIG_LOG_DEFAULT_LEVEL_INFO=y
CONFIG_LOG_TIMESTAMP_SOURCE_RTOS=y

# ===== Partition Table =====
CONFIG_PARTITION_TABLE_SINGLE_APP=y
CONFIG_PARTITION_TABLE_CUSTOM_FILENAME="partitions.csv"
CONFIG_PARTITION_TABLE_OFFSET=0x8000

# ===== Compiler Options =====
CONFIG_COMPILER_OPTIMIZATION_DEFAULT=y
CONFIG_COMPILER_OPTIMIZATION_ASSERTIONS_ENABLE=y

# ===== cJSON =====
CONFIG_CJSON_ENABLE=y

# ===== Suppress deprecated I2S warning =====
CONFIG_SUPPRESS_LEGACY_DRIVER_DEPRECATION_WARNING=y
```

## Speechster-ESP32-H2-Tesing-B1-PR1/INMP_441-Test/main/Kconfig.projbuild
```kconfig
menu "App Options"
    config ENABLE_MAX_DEBUG
        bool "Enable Maximum Debug Verbosity"
        default n
        help
            If enabled, the application will output extremely detailed debug logs,
            including per-chunk captures, retries, and low-level status.
endmenu
```

## Speechster-ESP32-S3-PR1/Main-Working/sdkconfig.defaults
```kconfig
# ─────────────────────────────────────────────
# Target
# ─────────────────────────────────────────────
CONFIG_IDF_TARGET="esp32s3"
CONFIG_ESPTOOLPY_FLASHSIZE_8MB=y

# ─────────────────────────────────────────────
# FreeRTOS
# ─────────────────────────────────────────────
CONFIG_FREERTOS_UNICORE=n
CONFIG_FREERTOS_HZ=1000
CONFIG_FREERTOS_USE_IDLE_HOOK=y
CONFIG_FREERTOS_THREAD_LOCAL_STORAGE_POINTERS=3
CONFIG_FREERTOS_IDLE_TASK_STACKSIZE=2048

# ─────────────────────────────────────────────
# Wi-Fi
# ─────────────────────────────────────────────
CONFIG_ESP_WIFI_AMPDU_TX_ENABLED=n

# ─────────────────────────────────────────────
# Bluetooth
# ─────────────────────────────────────────────
CONFIG_BT_ENABLED=y
CONFIG_BT_NIMBLE_ENABLED=y
CONFIG_BT_NIMBLE_HOST_TASK_STACK_SIZE=4096
CONFIG_BT_NIMBLE_MAX_CONNECTIONS=1
CONFIG_BT_NIMBLE_ATT_PREFERRED_MTU=517

# ─────────────────────────────────────────────
# ADC
# ─────────────────────────────────────────────
CONFIG_ADC_CALI_EFUSE_TP_ENABLE=y

# ─────────────────────────────────────────────
# Logging / UART
# ─────────────────────────────────────────────
CONFIG_LOG_DEFAULT_LEVEL_INFO=y
CONFIG_ESP_CONSOLE_UART_DEFAULT=y
CONFIG_ESP_CONSOLE_UART=y
CONFIG_ESP_CONSOLE_UART_NUM=0
CONFIG_ESP_CONSOLE_UART_BAUDRATE=115200
# CONFIG_ESP_CONSOLE_UART_TX_GPIO=43
# CONFIG_ESP_CONSOLE_UART_RX_GPIO=44

# ─────────────────────────────────────────────
# Power / Watchdog
# ─────────────────────────────────────────────
CONFIG_PM_ENABLE=y
CONFIG_ESP_TASK_WDT_TIMEOUT_S=15

# ─────────────────────────────────────────────
# Compiler / Optimization
# ─────────────────────────────────────────────
CONFIG_COMPILER_OPTIMIZATION_SIZE=y

# ─────────────────────────────────────────────
# Disable all USB features (ESP-IDF 6.x clean)
# ─────────────────────────────────────────────
CONFIG_ESP_CONSOLE_USB_CDC=n
CONFIG_ESP_CONSOLE_USB_SERIAL_JTAG=n
CONFIG_ESP_CONSOLE_UART_DEFAULT=y
CONFIG_ESP_CONSOLE_UART=y
```
